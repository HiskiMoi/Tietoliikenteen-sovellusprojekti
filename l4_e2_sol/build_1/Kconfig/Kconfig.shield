## l4_e2_sol/build_1/Kconfig/boards/Kconfig.sysbuild.tmp
```kconfig
# Load Sysbuild board Kconfig descriptions.
osource "C:/ncs/v3.4.2/zephyr/boards/nordic/nrf5340dk/Kconfig.sysbuild"
```

## l4_e2_sol/build_1/l4_e2_sol/Kconfig/boards/Kconfig.nrf5340dk
```kconfig
# Load board Kconfig descriptions.
osource "C:/ncs/v3.4.2/zephyr/boards/nordic/nrf5340dk/Kconfig.nrf5340dk"
```
